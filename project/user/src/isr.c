#include "isr.h"
//-------------------------------------------------------------------------------------------------------------------
// 函数简介     TIM1 的定时器更新中断服务函数 启动 .s 文件定义 不允许修改函数名称
//              默认优先级 修改优先级使用 interrupt_set_priority(TIM1_UP_IRQn, 1);
//-------------------------------------------------------------------------------------------------------------------
void TIM1_UP_IRQHandler (void)
{
    // 此处编写用户代码

    // 此处编写用户代码
    TIM1->SR &= ~TIM1->SR;                                                      // 清空中断状态
}

//-------------------------------------------------------------------------------------------------------------------
// 函数简介     TIM2 的定时器中断服务函数 启动 .s 文件定义 不允许修改函数名称
//              默认优先级 修改优先级使用 interrupt_set_priority(TIM2_IRQn, 1);
//-------------------------------------------------------------------------------------------------------------------
void TIM2_IRQHandler (void)
{
    // 此处编写用户代码
//按键处理*******************************************
				key_scanner();
				if(key_get_state     (KEY_1)){
						moveup();
            menu_display();
						key_clear_state  (KEY_1);
				}
				else if(key_get_state(KEY_2)){
						movedown();
            menu_display();
						key_clear_state  (KEY_2);
				}
				else if(key_get_state(KEY_3)){
						Sure();
            menu_display();
						key_clear_state  (KEY_3);
				}
				else if(key_get_state(KEY_4)){
						Back();
            menu_display();
						key_clear_state  (KEY_4);
				}			
//*************************************************
		// 此处编写用户代码
    TIM2->SR &= ~TIM2->SR;                                                      // 清空中断状态
}


//-------------------------------------------------------------------------------------------------------------------
// 函数简介     TIM3 的定时器中断服务函数 启动 .s 文件定义 不允许修改函数名称
//              默认优先级 修改优先级使用 interrupt_set_priority(TIM3_IRQn, 1);
//-------------------------------------------------------------------------------------------------------------------
void TIM3_IRQHandler (void)
{
    // 此处编写用户代码
//编码器模式
    // 此处编写用户代码
    TIM3->SR &= ~TIM3->SR;                                                      // 清空中断状态
}

//-------------------------------------------------------------------------------------------------------------------
// 函数简介     TIM4 的定时器中断服务函数 启动 .s 文件定义 不允许修改函数名称
//              默认优先级 修改优先级使用 interrupt_set_priority(TIM4_IRQn, 1);
//-------------------------------------------------------------------------------------------------------------------
void TIM4_IRQHandler (void)
{
    // 此处编写用户代码
//编码器模式
    // 此处编写用户代码
    TIM4->SR &= ~TIM4->SR;                                                      // 清空中断状态
}

//-------------------------------------------------------------------------------------------------------------------
// 函数简介     TIM5 的定时器中断服务函数 启动 .s 文件定义 不允许修改函数名称
//              默认优先级 修改优先级使用 interrupt_set_priority(TIM5_IRQn, 1);
//-------------------------------------------------------------------------------------------------------------------
void TIM5_IRQHandler (void)
{
    // 此处编写用户代码
		//定时器五用于PWM输出
    // 此处编写用户代码
    TIM5->SR &= ~TIM5->SR;                                                      // 清空中断状态
}


//-------------------------------------------------------------------------------------------------------------------
// 函数简介     TIM6 的定时器中断服务函数 启动 .s 文件定义 不允许修改函数名称
//              默认优先级 修改优先级使用 interrupt_set_priority(TIM6_IRQn, 1);
//-------------------------------------------------------------------------------------------------------------------
int32 encoder1;
int32 encoder2;
int32 en_speed1;
int32 en_speed2;
int32 en_location1;
int32 en_location2;
extern PID_t Speed_l;
extern PID_t Speed_r;
uint8 count1=0;
uint8 countShow=0;
int16 Left_PWM_Out;
int16 Right_PWM_Out;
extern PID_t Turn_t;
extern PID_t Gyro_t;
uint8 countData=0;
void TIM6_IRQHandler (void)
{
		countData++;
//100ms更新速度环 (//速度决策) 
		if(countData>=10){
//************编码器1(左轮)**************
		encoder1=encoder_get_count(TIM3_ENCODER);
		en_speed1=encoder1;
		en_location1+=encoder1;
		encoder_clear_count(TIM3_ENCODER);
//************************************

//************编码器2(右轮)**************
		encoder2=encoder_get_count(TIM4_ENCODER);
		en_speed2=(-encoder2);//-是因为极性问题
		en_location2+=(-encoder2);//-是因为极性问题
		encoder_clear_count(TIM4_ENCODER);
//************************************
		Speed_l.Actual=(en_speed1+en_speed2)/2;
		Speed_r.Actual=(en_speed1+en_speed2)/2;
//				float Handle_Speed=HandleSpeed(ZhongZhi);//直道1800，弯道降速到900
//				Speed_l.Target=Handle_Speed;
//				Speed_r.Target=Handle_Speed;
		PID_Position_Update(&Speed_l);	
		PID_Position_Update(&Speed_r);
//************屏幕最底下显示数据************
//		ips200_show_string(0, 256,"Speed1:");
//		ips200_show_int(56, 256, en_speed1, 5);
//		ips200_show_string(0, 272,"Location1:");
//		ips200_show_int(80, 272, en_location1, 6);
//		ips200_show_string(0, 288,"Speed2:");
//		ips200_show_int(56, 288, en_speed2, 5);
//		ips200_show_string(0, 304,"Location2:");
//		ips200_show_int(80, 304, en_location2, 6);
		}
//10ms获取陀螺仪数据***************************************
		mpu6050_get_acc();     // 获取 MPU6050 的加速度测量数值
    mpu6050_get_gyro();    // 获取 MPU6050 的角速度测量数值
//		ips200_show_string(0, 16,"gyro_x:");
//		ips200_show_int(56, 16,mpu6050_gyro_x, 5);
//		ips200_show_string(0, 32,"gyro_y:");
//		ips200_show_int(56, 32,mpu6050_gyro_y, 5);
//		ips200_show_string(0, 48,"gyro_z:");
//		ips200_show_int(56, 48,mpu6050_gyro_z, 5);
//	
//		ips200_show_string(96, 16,"acc_x:");
//		ips200_show_int(144, 16,mpu6050_acc_x, 5);
//		ips200_show_string(96, 32,"acc_y:");
//		ips200_show_int(144, 32,mpu6050_acc_y, 5);
//		ips200_show_string(96, 48,"acc_z:");
//		ips200_show_int(144, 48,mpu6050_acc_z, 5);
    TIM6->SR &= ~TIM6->SR;// 清空中断状态                                                
}
//定时器中断7 （1ms进一次）
void TIM7_IRQHandler (void)
{		 
		count1++;
//1ms更新转向环PID
		if(count1>=1){
				if(pid_flag==1){
						//更新转向环
						Turn_t.Actual =ZhongZhi;
						PID_Three_Update(&Turn_t);								 //误差三次方pid 还差个陀螺仪
//						PID_KpTwo_Update(&Turn_t);									//Kp平滑分段pid					
//						PID_Position_Update(&Turn_t);								 //普通位置式pid
//同时更新左右轮速度差环（速度追赶机制）
//						Speed_BuChang_t.Actual=en_speed1-en_speed2;
//						PID_Position_Update(&Speed_BuChang_t);	
						pid_flag=0;		
				}
				count1=0;
		}
//1msPID输出
		if(YueJie_flag==0 && Motor_Protection_flag==0 && Buzzer_Stop_flag==0){  //正常循迹4
		//串级PID
				Left_PWM_Out =Speed_l.Out - Turn_t.Out ;
				Right_PWM_Out=Speed_r.Out + Turn_t.Out ;
		//PID输出
				if(Left_PWM_Out<0)Left_PWM_Out=0;
				if(Right_PWM_Out<0)Right_PWM_Out=0;
				Motor_Left_PWM (Left_PWM_Out );
				Motor_Right_PWM(Right_PWM_Out);	
		}
		else if(YueJie_flag==1 || Motor_Protection_flag==1 || Buzzer_Stop_flag==1){//1.越界了2.电机过快3.过斑马线
				Motor_Left_PWM (0);
				Motor_Right_PWM(0);
		}
////显示输出值
//				ips200_show_string (110,256,"L_PWM:");
//				ips200_show_int   (158,256,Left_PWM_Out, 4);
//				ips200_show_string (110,288,"R_PWM:");
//				ips200_show_int   (158,288,Right_PWM_Out,4);
//			
//				countShow=0;
// 此处编写用户代码
    TIM7->SR &= ~TIM7->SR;// 清空中断状态
}

//-------------------------------------------------------------------------------------------------------------------
// 函数简介     TIM8 的定时器更新中断服务函数 启动 .s 文件定义 不允许修改函数名称
//              默认优先级 修改优先级使用 interrupt_set_priority(TIM8_UP_IRQn, 1);
//-------------------------------------------------------------------------------------------------------------------
void TIM8_UP_IRQHandler (void)
{
    tsl1401_collect_pit_handler();
    // 此处编写用户代码

    // 此处编写用户代码
    TIM8->SR &= ~TIM8->SR;                                                      // 清空中断状态
}

//-------------------------------------------------------------------------------------------------------------------
// 函数简介     UART1 的串口中断服务函数 启动 .s 文件定义 不允许修改函数名称
//              默认优先级 修改优先级使用 interrupt_set_priority(UART1_IRQn, 1);
//-------------------------------------------------------------------------------------------------------------------
void UART1_IRQHandler (void)
{
    if(UART1->ISR & 0x00000001)                                                 // 串口发送缓冲空中断
    {
        // 此处编写用户代码
        // 务必填写数据或者关闭中断 否则会一直触发串口发送中断

        // 此处编写用户代码
        UART1->ICR |= 0x00000001;                                               // 清除中断标志位
    }
    if(UART1->ISR & 0x00000002)                                                 // 串口接收缓冲中断
    {
#if DEBUG_UART_USE_INTERRUPT                                                    // 如果开启 debug 串口中断
        debug_interrupr_handler();                                              // 调用 debug 串口接收处理函数 数据会被 debug 环形缓冲区读取
#endif                                                                          // 如果修改了 DEBUG_UART_INDEX 那这段代码需要放到对应的串口中断去
        // 此处编写用户代码
        // 务必读取数据或者关闭中断 否则会一直触发串口接收中断

        // 此处编写用户代码
        UART1->ICR |= 0x00000002;                                               // 清除中断标志位
    }
}

//-------------------------------------------------------------------------------------------------------------------
// 函数简介     UART2 的串口中断服务函数 启动 .s 文件定义 不允许修改函数名称
//              默认优先级 修改优先级使用 interrupt_set_priority(UART2_IRQn, 1);
//-------------------------------------------------------------------------------------------------------------------
void UART2_IRQHandler (void)
{
    if(UART2->ISR & 0x00000001)                                                 // 串口发送缓冲空中断
    {
        // 此处编写用户代码
        // 务必填写数据或者关闭中断 否则会一直触发串口发送中断

        // 此处编写用户代码
        UART2->ICR |= 0x00000001;                                               // 清除中断标志位
    }
    if(UART2->ISR & 0x00000002)                                                 // 串口接收缓冲中断
    {
        gps_uart_callback();
        // 此处编写用户代码
        // 务必读取数据或者关闭中断 否则会一直触发串口接收中断

        // 此处编写用户代码
        UART2->ICR |= 0x00000002;                                               // 清除中断标志位
    }
}

//-------------------------------------------------------------------------------------------------------------------
// 函数简介     UART3 的串口中断服务函数 启动 .s 文件定义 不允许修改函数名称
//              默认优先级 修改优先级使用 interrupt_set_priority(UART3_IRQn, 1);
//-------------------------------------------------------------------------------------------------------------------
void UART3_IRQHandler (void)
{
    if(UART3->ISR & 0x00000001)                                                 // 串口发送缓冲空中断
    {
        // 此处编写用户代码
        // 务必填写数据或者关闭中断 否则会一直触发串口发送中断

        // 此处编写用户代码
        UART3->ICR |= 0x00000001;                                               // 清除中断标志位
    }
    if(UART3->ISR & 0x00000002)                                                 // 串口接收缓冲中断
    {
        // 此处编写用户代码
        // 务必读取数据或者关闭中断 否则会一直触发串口接收中断

        // 此处编写用户代码
        UART3->ICR |= 0x00000002;                                               // 清除中断标志位
    }
}

//-------------------------------------------------------------------------------------------------------------------
// 函数简介     UART4 的串口中断服务函数 启动 .s 文件定义 不允许修改函数名称
//              默认优先级 修改优先级使用 interrupt_set_priority(UART4_IRQn, 1);
//-------------------------------------------------------------------------------------------------------------------
void UART4_IRQHandler (void)
{
    if(UART4->ISR & 0x00000001)                                                 // 串口发送缓冲空中断
    {
        // 此处编写用户代码
        // 务必填写数据或者关闭中断 否则会一直触发串口发送中断

        // 此处编写用户代码
        UART4->ICR |= 0x00000001;                                               // 清除中断标志位
    }
    if(UART4->ISR & 0x00000002)                                                 // 串口接收缓冲中断
    {
        // 此处编写用户代码
        // 务必读取数据或者关闭中断 否则会一直触发串口接收中断

        // 此处编写用户代码
        UART4->ICR |= 0x00000002;                                               // 清除中断标志位
    }
}

//-------------------------------------------------------------------------------------------------------------------
// 函数简介     UART5 的串口中断服务函数 启动 .s 文件定义 不允许修改函数名称
//              默认优先级 修改优先级使用 interrupt_set_priority(UART5_IRQn, 1);
//-------------------------------------------------------------------------------------------------------------------
void UART5_IRQHandler (void)
{
    if(UART5->ISR & 0x00000001)                                                 // 串口发送缓冲空中断
    {
        // 此处编写用户代码
        // 务必填写数据或者关闭中断 否则会一直触发串口发送中断

        // 此处编写用户代码
        UART5->ICR |= 0x00000001;                                               // 清除中断标志位
    }
    if(UART5->ISR & 0x00000002)                                                 // 串口接收缓冲中断
    {
        // 此处编写用户代码
        // 务必读取数据或者关闭中断 否则会一直触发串口接收中断

        // 此处编写用户代码
        UART5->ICR |= 0x00000002;                                               // 清除中断标志位
    }
}

//-------------------------------------------------------------------------------------------------------------------
// 函数简介     UART6 的串口中断服务函数 启动 .s 文件定义 不允许修改函数名称
//              默认优先级 修改优先级使用 interrupt_set_priority(UART6_IRQn, 1);
//-------------------------------------------------------------------------------------------------------------------
void UART6_IRQHandler (void)
{
    if(UART6->ISR & 0x00000001)                                                 // 串口发送缓冲空中断
    {
        // 此处编写用户代码
        // 务必填写数据或者关闭中断 否则会一直触发串口发送中断

        // 此处编写用户代码
        UART6->ICR |= 0x00000001;                                               // 清除中断标志位
    }
    if(UART6->ISR & 0x00000002)                                                 // 串口接收缓冲中断
    {
        wireless_module_uart_handler();
        // 此处编写用户代码
        // 务必读取数据或者关闭中断 否则会一直触发串口接收中断

        // 此处编写用户代码
        UART6->ICR |= 0x00000002;                                               // 清除中断标志位
    }
}

//-------------------------------------------------------------------------------------------------------------------
// 函数简介     UART7 的串口中断服务函数 启动 .s 文件定义 不允许修改函数名称
//              默认优先级 修改优先级使用 interrupt_set_priority(UART7_IRQn, 1);
//-------------------------------------------------------------------------------------------------------------------
void UART7_IRQHandler (void)
{
    if(UART7->ISR & 0x00000001)                                                 // 串口发送缓冲空中断
    {
        // 此处编写用户代码
        // 务必填写数据或者关闭中断 否则会一直触发串口发送中断

        // 此处编写用户代码
        UART7->ICR |= 0x00000001;                                               // 清除中断标志位
    }
    if(UART7->ISR & 0x00000002)                                                 // 串口接收缓冲中断
    {
        // 此处编写用户代码
        // 务必读取数据或者关闭中断 否则会一直触发串口接收中断

        // 此处编写用户代码
        UART7->ICR |= 0x00000002;                                               // 清除中断标志位
    }
}

//-------------------------------------------------------------------------------------------------------------------
// 函数简介     UART8 的串口中断服务函数 启动 .s 文件定义 不允许修改函数名称
//              默认优先级 修改优先级使用 interrupt_set_priority(UART8_IRQn, 1);
//-------------------------------------------------------------------------------------------------------------------
void UART8_IRQHandler (void)
{
    if(UART8->ISR & 0x00000001)                                                 // 串口发送缓冲空中断
    {
        // 此处编写用户代码
        // 务必填写数据或者关闭中断 否则会一直触发串口发送中断

        // 此处编写用户代码
        UART8->ICR |= 0x00000001;                                               // 清除中断标志位
    }
    if(UART8->ISR & 0x00000002)                                                 // 串口接收缓冲中断
    {
        camera_uart_handler();
        // 此处编写用户代码
        // 务必读取数据或者关闭中断 否则会一直触发串口接收中断

        // 此处编写用户代码
        UART8->ICR |= 0x00000002;                                               // 清除中断标志位
    }
}

//-------------------------------------------------------------------------------------------------------------------
// 函数简介     外部中断 EXTI0 线 的中断服务函数 启动 .s 文件定义 不允许修改函数名称
//              默认优先级 修改优先级使用 interrupt_set_priority(EXTI0_IRQn, 1);
//-------------------------------------------------------------------------------------------------------------------
void EXTI0_IRQHandler (void)
{
    // 此处编写用户代码 (A0/B0..H0) 引脚触发

    // 此处编写用户代码 (A0/B0..H0) 引脚触发
    EXTI->PR |= (0x00000001 << 0);                                              // 清除 line0 触发标志
}

//-------------------------------------------------------------------------------------------------------------------
// 函数简介     外部中断 EXTI1 线 的中断服务函数 启动 .s 文件定义 不允许修改函数名称
//              默认优先级 修改优先级使用 interrupt_set_priority(EXTI1_IRQn, 1);
//-------------------------------------------------------------------------------------------------------------------
void EXTI1_IRQHandler (void)
{
    // 此处编写用户代码 (A1/B1..H1) 引脚触发

    // 此处编写用户代码 (A1/B1..H1) 引脚触发
    EXTI->PR |= (0x00000001 << 1);                                              // 清除 line1 触发标志
}

//-------------------------------------------------------------------------------------------------------------------
// 函数简介     外部中断 EXTI2 线 的中断服务函数 启动 .s 文件定义 不允许修改函数名称
//              默认优先级 修改优先级使用 interrupt_set_priority(EXTI2_IRQn, 1);
//-------------------------------------------------------------------------------------------------------------------
void EXTI2_IRQHandler (void)
{
    // 此处编写用户代码 (A2/B2..H2) 引脚触发

    // 此处编写用户代码 (A2/B2..H2) 引脚触发
    EXTI->PR |= (0x00000001 << 2);                                              // 清除 line2 触发标志
}

//-------------------------------------------------------------------------------------------------------------------
// 函数简介     外部中断 EXTI3 线 的中断服务函数 启动 .s 文件定义 不允许修改函数名称
//              默认优先级 修改优先级使用 interrupt_set_priority(EXTI3_IRQn, 1);
//-------------------------------------------------------------------------------------------------------------------
void EXTI3_IRQHandler (void)
{
    // 此处编写用户代码 (A3/B3..H3) 引脚触发

    // 此处编写用户代码 (A3/B3..H3) 引脚触发
    EXTI->PR |= (0x00000001 << 3);                                              // 清除 line3 触发标志
}

//-------------------------------------------------------------------------------------------------------------------
// 函数简介     外部中断 EXTI4 线 的中断服务函数 启动 .s 文件定义 不允许修改函数名称
//              默认优先级 修改优先级使用 interrupt_set_priority(EXTI4_IRQn, 1);
//-------------------------------------------------------------------------------------------------------------------
void EXTI4_IRQHandler (void)
{
    // -----------------* DL1A INT 更新中断 预置中断处理函数 *-----------------
    dl1a_int_handler();
    // -----------------* DL1A INT 更新中断 预置中断处理函数 *-----------------
    // 此处编写用户代码 (A4/B4..G4) 引脚触发

    // 此处编写用户代码 (A4/B4..G4) 引脚触发
    EXTI->PR |= (0x00000001 << 4);                                              // 清除 line4 触发标志
}

//-------------------------------------------------------------------------------------------------------------------
// 函数简介     外部中断 EXTI9-5 线 的中断服务函数 启动 .s 文件定义 不允许修改函数名称
//              默认优先级 修改优先级使用 interrupt_set_priority(EXTI9_5_IRQn, 1);
//-------------------------------------------------------------------------------------------------------------------
void EXTI9_5_IRQHandler (void)
{
    if(EXTI->PR & (0x00000001 << 5))                                            // 检测 line5 是否触发
    {
        // 此处编写用户代码 (A5/B5..G5) 引脚触发

        // 此处编写用户代码 (A5/B5..G5) 引脚触发
        EXTI->PR |= (0x00000001 << 5);                                          // 清除 line5 触发标志
    }
    if(EXTI->PR & (0x00000001 << 6))                                            // 检测 line6 是否触发
    {
        camera_vsync_handler();
        // 此处编写用户代码 (A6/B6..G6) 引脚触发

        // 此处编写用户代码 (A6/B6..G6) 引脚触发
        EXTI->PR |= (0x00000001 << 6);                                          // 清除 line6 触发标志
    }
    if(EXTI->PR & (0x00000001 << 7))                                            // 检测 line7 是否触发
    {
        // 此处编写用户代码 (A7/B7..G7) 引脚触发

        // 此处编写用户代码 (A7/B7..G7) 引脚触发
        EXTI->PR |= (0x00000001 << 7);                                          // 清除 line7 触发标志
    }
    if(EXTI->PR & (0x00000001 << 8))                                            // 检测 line8 是否触发
    {
        // 此处编写用户代码 (A8/B8..G8) 引脚触发

        // 此处编写用户代码 (A8/B8..G8) 引脚触发
        EXTI->PR |= (0x00000001 << 8);                                          // 清除 line8 触发标志
    }
    if(EXTI->PR & (0x00000001 << 9))                                            // 检测 line9 是否触发
    {
        // 此处编写用户代码 (A9/B9..G9) 引脚触发

        // 此处编写用户代码 (A9/B9..G9) 引脚触发
        EXTI->PR |= (0x00000001 << 9);                                          // 清除 line9 触发标志
    }
}

//-------------------------------------------------------------------------------------------------------------------
// 函数简介     外部中断 EXTI15-10(A15-10/B15-10..G15-10) 线 的中断服务函数 启动 .s 文件定义 不允许修改函数名称
//              默认优先级 修改优先级使用 interrupt_set_priority(EXTI15_10_IRQn, 1);
//-------------------------------------------------------------------------------------------------------------------
void EXTI15_10_IRQHandler (void)
{
    if(EXTI->PR & (0x00000001 << 10))                                           // 检测 line10 是否触发
    {
        // -----------------* DM1XA 光信号 预置中断处理函数 *-----------------
        dm1xa_light_callback();
        // -----------------* DM1XA 光信号 预置中断处理函数 *-----------------
        // 此处编写用户代码 (A10/B10..G10) 引脚触发

        // 此处编写用户代码 (A10/B10..G10) 引脚触发
        EXTI->PR |= (0x00000001 << 10);                                         // 清除 line10 触发标志
    }
    if(EXTI->PR & (0x00000001 << 11))                                           // 检测 line11 是否触发
    {
        // -----------------* DM1XA 声/反馈信号 预置中断处理函数 *-----------------
        dm1xa_sound_callback();
        // -----------------* DM1XA 声/反馈信号 预置中断处理函数 *-----------------
        // 此处编写用户代码 (A11/B11..G11) 引脚触发

        // 此处编写用户代码 (A11/B11..G11) 引脚触发
        EXTI->PR |= (0x00000001 << 11);                                         // 清除 line11 触发标志
    }
    if(EXTI->PR & (0x00000001 << 12))                                           // 检测 line12 是否触发
    {
        // 此处编写用户代码 (A12/B12..G12) 引脚触发

        // 此处编写用户代码 (A12/B12..G12) 引脚触发
        EXTI->PR |= (0x00000001 << 12);                                         // 清除 line12 触发标志
    }
    if(EXTI->PR & (0x00000001 << 13))                                           // 检测 line13 是否触发
    {
        // 此处编写用户代码 (A13/B13..G13) 引脚触发

        // 此处编写用户代码 (A13/B13..G13) 引脚触发
        EXTI->PR |= (0x00000001 << 13);                                         // 清除 line13 触发标志
    }
    if(EXTI->PR & (0x00000001 << 14))                                           // 检测 line14 是否触发
    {
        // 此处编写用户代码 (A14/B14..G14) 引脚触发

        // 此处编写用户代码 (A14/B14..G14) 引脚触发
        EXTI->PR |= (0x00000001 << 14);                                         // 清除 line14 触发标志
    }
    if(EXTI->PR & (0x00000001 << 15))                                           // 检测 line15 是否触发
    {
        // 此处编写用户代码 (A15/B15..G15) 引脚触发

        // 此处编写用户代码 (A15/B15..G15) 引脚触发
        EXTI->PR |= (0x00000001 << 15);                                         // 清除 line15 触发标志
    }
}

//-------------------------------------------------------------------------------------------------------------------
// 函数简介     DMA1 通道 1 的中断服务函数 启动 .s 文件定义 不允许修改函数名称
//              默认优先级 修改优先级使用 interrupt_set_priority(DMA1_CH1_IRQn, 1);
//-------------------------------------------------------------------------------------------------------------------
void DMA1_Channel1_IRQHandler (void)
{
    if(DMA1->ISR & (0x00000001 << (0 * 4)))                                     // 判断触发通道
    {
        // 此处编写用户代码

        // 此处编写用户代码
        DMA1->IFCR |= (0x00000001 << (0 * 4));                                  // 清空该通道中断标志
    }
}

//-------------------------------------------------------------------------------------------------------------------
// 函数简介     DMA1 通道 2 的中断服务函数 启动 .s 文件定义 不允许修改函数名称
//              默认优先级 修改优先级使用 interrupt_set_priority(DMA1_CH2_IRQn, 1);
//-------------------------------------------------------------------------------------------------------------------
void DMA1_Channel2_IRQHandler (void)
{
    if(DMA1->ISR & (0x00000001 << (1 * 4)))                                     // 判断触发通道
    {
        // 此处编写用户代码

        // 此处编写用户代码
        DMA1->IFCR |= (0x00000001 << (1 * 4));                                  // 清空该通道中断标志
    }
}

//-------------------------------------------------------------------------------------------------------------------
// 函数简介     DMA1 通道 3 的中断服务函数 启动 .s 文件定义 不允许修改函数名称
//              默认优先级 修改优先级使用 interrupt_set_priority(DMA1_CH3_IRQn, 1);
//-------------------------------------------------------------------------------------------------------------------
void DMA1_Channel3_IRQHandler (void)
{
    if(DMA1->ISR & (0x00000001 << (2 * 4)))                                     // 判断触发通道
    {
        // 此处编写用户代码

        // 此处编写用户代码
        DMA1->IFCR |= (0x00000001 << (2 * 4));                                  // 清空该通道中断标志
    }
}

//-------------------------------------------------------------------------------------------------------------------
// 函数简介     DMA1 通道 4 的中断服务函数 启动 .s 文件定义 不允许修改函数名称
//              默认优先级 修改优先级使用 interrupt_set_priority(DMA1_CH4_IRQn, 1);
//-------------------------------------------------------------------------------------------------------------------
void DMA1_Channel4_IRQHandler (void)
{
    if(DMA1->ISR & (0x00000001 << (3 * 4)))                                     // 判断触发通道
    {
        camera_dma_handler();
        // 此处编写用户代码

        // 此处编写用户代码
        DMA1->IFCR |= (0x00000001 << (3 * 4));                                  // 清空该通道中断标志
    }
}

//-------------------------------------------------------------------------------------------------------------------
// 函数简介     DMA1 通道 5 的中断服务函数 启动 .s 文件定义 不允许修改函数名称
//              默认优先级 修改优先级使用 interrupt_set_priority(DMA1_CH5_IRQn, 1);
//-------------------------------------------------------------------------------------------------------------------
void DMA1_Channel5_IRQHandler (void)
{
    if(DMA1->ISR & (0x00000001 << (4 * 4)))                                     // 判断触发通道
    {
        // 此处编写用户代码

        // 此处编写用户代码
        DMA1->IFCR |= (0x00000001 << (4 * 4));                                  // 清空该通道中断标志
    }
}

//-------------------------------------------------------------------------------------------------------------------
// 函数简介     DMA1 通道 6 的中断服务函数 启动 .s 文件定义 不允许修改函数名称
//              默认优先级 修改优先级使用 interrupt_set_priority(DMA1_CH6_IRQn, 1);
//-------------------------------------------------------------------------------------------------------------------
void DMA1_Channel6_IRQHandler (void)
{
    if(DMA1->ISR & (0x00000001 << (5 * 4)))                                     // 判断触发通道
    {
        // 此处编写用户代码

        // 此处编写用户代码
        DMA1->IFCR |= (0x00000001 << (5 * 4));                                  // 清空该通道中断标志
    }
}

//-------------------------------------------------------------------------------------------------------------------
// 函数简介     DMA1 通道 7 的中断服务函数 启动 .s 文件定义 不允许修改函数名称
//              默认优先级 修改优先级使用 interrupt_set_priority(DMA1_CH7_IRQn, 1);
//-------------------------------------------------------------------------------------------------------------------
void DMA1_Channel7_IRQHandler (void)
{
    if(DMA1->ISR & (0x00000001 << (6 * 4)))                                     // 判断触发通道
    {
        // 此处编写用户代码

        // 此处编写用户代码
        DMA1->IFCR |= (0x00000001 << (6 * 4));                                  // 清空该通道中断标志
    }
}

//-------------------------------------------------------------------------------------------------------------------
// 函数简介     DMA2 通道 1 的中断服务函数 启动 .s 文件定义 不允许修改函数名称
//              默认优先级 修改优先级使用 interrupt_set_priority(DMA2_CH1_IRQn, 1);
//-------------------------------------------------------------------------------------------------------------------
void DMA2_Channel1_IRQHandler (void)
{
    if(DMA2->ISR & (0x00000001 << (0 * 4)))                                     // 判断触发通道
    {
        // 此处编写用户代码

        // 此处编写用户代码
        DMA2->IFCR |= (0x00000001 << (0 * 4));                                  // 清空该通道中断标志
    }
}

//-------------------------------------------------------------------------------------------------------------------
// 函数简介     DMA2 通道 2 的中断服务函数 启动 .s 文件定义 不允许修改函数名称
//              默认优先级 修改优先级使用 interrupt_set_priority(DMA2_CH2_IRQn, 1);
//-------------------------------------------------------------------------------------------------------------------
void DMA2_Channel2_IRQHandler (void)
{
    if(DMA2->ISR & (0x00000001 << (1 * 4)))                                     // 判断触发通道
    {
        // 此处编写用户代码

        // 此处编写用户代码
        DMA2->IFCR |= (0x00000001 << (1 * 4));                                  // 清空该通道中断标志
    }
}

//-------------------------------------------------------------------------------------------------------------------
// 函数简介     DMA2 通道 3 的中断服务函数 启动 .s 文件定义 不允许修改函数名称
//              默认优先级 修改优先级使用 interrupt_set_priority(DMA2_CH3_IRQn, 1);
//-------------------------------------------------------------------------------------------------------------------
void DMA2_Channel3_IRQHandler (void)
{
    if(DMA2->ISR & (0x00000001 << (2 * 4)))                                     // 判断触发通道
    {
        // 此处编写用户代码

        // 此处编写用户代码
        DMA2->IFCR |= (0x00000001 << (2 * 4));                                  // 清空该通道中断标志
    }
}

//-------------------------------------------------------------------------------------------------------------------
// 函数简介     DMA2 通道 4 的中断服务函数 启动 .s 文件定义 不允许修改函数名称
//              默认优先级 修改优先级使用 interrupt_set_priority(DMA2_CH4_IRQn, 1);
//-------------------------------------------------------------------------------------------------------------------
void DMA2_Channel4_IRQHandler (void)
{
    if(DMA2->ISR & (0x00000001 << (3 * 4)))                                     // 判断触发通道
    {
        // 此处编写用户代码

        // 此处编写用户代码
        DMA2->IFCR |= (0x00000001 << (3 * 4));                                  // 清空该通道中断标志
    }
}

//-------------------------------------------------------------------------------------------------------------------
// 函数简介     DMA2 通道 5 的中断服务函数 启动 .s 文件定义 不允许修改函数名称
//              默认优先级 修改优先级使用 interrupt_set_priority(DMA2_CH5_IRQn, 1);
//-------------------------------------------------------------------------------------------------------------------
void DMA2_Channel5_IRQHandler (void)
{
    if(DMA2->ISR & (0x00000001 << (4 * 4)))                                     // 判断触发通道
    {
        // 此处编写用户代码

        // 此处编写用户代码
        DMA2->IFCR |= (0x00000001 << (4 * 4));                                  // 清空该通道中断标志
    }
}

